## src/Kconfig
```kconfig
config SRCARCH
    string
    default 'i386'

#source "kernel/Kconfig"
source "arch/$SRCARCH/Kconfig"
```

## src/arch/i386/Kconfig
```kconfig
config CROSS_COMPILE
	string "Cross-compiler tool prefix"
	help
	  Same as running 'make CROSS_COMPILE=prefix-' but stored for
	  default make runs in this kernel build directory.  You don't
	  need to set this unless you want the configured kernel build
	  directory to select the cross-compiler automatically.
    default "i686-pc-chronos-" 


config ARCH
    string "The target architecture of the build"
    default "i386"

source "arch/i386/boot/Kconfig"
```

## src/arch/i386/boot/Kconfig
```kconfig
config FS_START
    int
    default 2048

config FS_DD_BS
    int
    default 512

config FS_DD_COUNT
    int
    default 2097152

config FS_TYPE
    string
    default "ext2.img"

config DISK_SZ
    int
    default 1074790400

config BOOT_STAGE2_SECTORS
    int
    default 140
```
